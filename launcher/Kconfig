## launcher/Kconfig
```kconfig
config XMSDEMO_LAUNCHER
	tristate "native xms launcher"
	default n
	depends on SYSTEM_SERVER
	depends on SYSTEM_ACTIVITY_SERVICE
	depends on SYSTEM_WINDOW_SERVICE
	depends on SYSTEM_PACKAGE_SERVICE
	---help---
		Enable the Launcher Demo App for AMS/WMS/PMS.
```

## lvgldemo/Kconfig
```kconfig
config XMSDEMO_LVGLDEMO
	tristate "native xms lvgl demo"
	default n
	depends on SYSTEM_SERVER
	depends on SYSTEM_ACTIVITY_SERVICE
	depends on SYSTEM_WINDOW_SERVICE
	depends on SYSTEM_PACKAGE_SERVICE
	depends on LV_USE_DEMO_MUSIC
	depends on LV_USE_DEMO_WIDGETS
	---help---
		Enable the Lvgl Demo App for AMS/WMS/PMS.
```

## service/Kconfig
```kconfig
config XMSDEMO_SERVICE
	tristate "native xms service demo"
	default n
	depends on SYSTEM_SERVER
	depends on SYSTEM_ACTIVITY_SERVICE
	depends on SYSTEM_WINDOW_SERVICE
	depends on SYSTEM_PACKAGE_SERVICE
	---help---
		Enable the Native Service Demo for AMS/WMS/PMS.
```

## window/Kconfig
```kconfig
config XMSDEMO_WINDOW
	tristate "native xms window demo"
	default n
	depends on SYSTEM_SERVER
	depends on SYSTEM_ACTIVITY_SERVICE
	depends on SYSTEM_WINDOW_SERVICE
	depends on SYSTEM_PACKAGE_SERVICE
	---help---
		Enable the Native Service App for AMS/WMS/PMS.
```
